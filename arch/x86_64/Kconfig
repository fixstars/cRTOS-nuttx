## arch/x86_64/Kconfig
```kconfig
#
# For a description of the syntax of this configuration file,
# see the file kconfig-language.txt in the NuttX tools repository.
#

if ARCH_X86_64
comment "x86_64 Configuration Options"

config ARCH
	string
	default "x86_64"

choice
	prompt "x86_64 arch selection"
	default ARCH_INTEL64

config ARCH_INTEL64
	bool "Intel x86_64"
	select ARCH_HAVE_MPU
	select ARCH_USE_MPU
    select ARCH_HAVE_TICKLESS
    select ARCH_HAVE_STACKCHECK
	select ARCH_HAVE_RNG
	---help---
		Intel x86_64 architecture

endchoice

choice
	prompt "x86_64 system selection"
	default ARCH_BOARD_QEMU

config ARCH_BOARD_QEMU
	bool "Qemu envrionment"
	---help---
		Targeting virtualized qemu environment

endchoice

source arch/x86_64/src/common/Kconfig

if ARCH_INTEL64
source arch/x86_64/src/intel64/Kconfig

config ARCH_CHIP
	string
	default "intel64"

endif # ARCH_INTEL64

if ARCH_BOARD_QEMU
source arch/x86_64/src/qemu/Kconfig

config ARCH_BOARD
	string
	default "qemu-intel64"

endif # ARCH_CHIP_QEMU

config ARCH_EXCLUDE_MULTIBOOT
	bool "Don't append multiboot2 header"
	default n
    ---help---
        Some platforms, e.g. jailhouse, do not like to have a multiboot header

config CRTOS
	bool "cRTOS support"
	default n
	---help---
		Enable support to act as the RTOS in cRTOS

if CRTOS

config TUX_FD_RESERVE
	int "FDs reserved for normal realm"
	default 512

config TUX_USER_ADDR_START
	hex "Start address of memory reserved for tux user-space"
	default 0x8000000

config TUX_USER_ADDR_SIZE
	hex "Size of memory reserved for tux user-space"
	default 0x20000000

endif # CRTOS

config VIRT_SHADOW
	bool "Driver for cRTOS shadow device"
	default n
	select PCI
	---help---
		Driver for cRTOS shadow device, based on Ivshmem 2.0

if VIRT_SHADOW

config VIRT_SHADOW_BASE_IRQ
	int "Base IRQ Number for shadow device"
	default 0

endif

endif # ARCH_X86_64
```

## arch/x86_64/src/linux_subsystem/Kconfig
```kconfig
#
# For a description of the syntax of this configuration file,
# see the file kconfig-language.txt in the NuttX tools repository.
#

comment "Linux_subsystem Configuration Options"

config TUX_FD_RESERVE
	int "Number of FDs reserved for Linux files"
    default 64
```

## boards/x86_64/intel64/qemu-intel64/Kconfig
```kconfig
#
# For a description of the syntax of this configuration file,
# see the file kconfig-language.txt in the NuttX tools repository.
#
#
config QEMU_PCI
	bool "Initialize and enumerate PCI/PCI-E Bus"
	default n
	select PCI
	select BOARD_EARLY_INITIALIZE

	---help---
		Enables initialization and scaning of standard x86-64 PCI/PCI-E bus.

config QEMU_PCI_BAR_PAGE_COUNT
	int "Number pages reserved for mapping uninitialized bars"
	default 16
	depends on QEMU_PCI
	depends on GRAN

	---help---
		Most of the time BIOS/EFI or bootloader will map the PCI/PCI-E's bar
		for us. However, in certain scenario, the device bar may be unmapped.
		This option set the number of pages in memory space reserved for 
		mapping the bars.
```

## drivers/pci/Kconfig
```kconfig
#
# For a description of the syntax of this configuration file,
# see the file kconfig-language.txt in the NuttX tools repository.
#

menuconfig PCI
	bool "Support for PCI Bus"
	default n
	---help---
		Enables support for the PCI/PCI-E bus.
		Backend bust be provided by per-arch or per-board implementation..

if PCI
config PCI_MAX_BDF
	hex "Maximum bdf to scan on PCI/PCI-E bus"
	default 0x10000
	---help---
		The maximum bdf number to be scanned on PCI/PCI-E bus

endif
```

## drivers/virt/Kconfig
```kconfig
#
# For a description of the syntax of this configuration file,
# see the file kconfig-language.txt in the NuttX tools repository.
#
#
#
menuconfig VIRT
	bool "Virtualization"
	default n
	---help---
		Drivers for virtualized and emulated devices

if VIRT

config VIRT_QEMU_PCI_TEST
	bool "Driver for QEMU PCI test device"
	default n
	select PCI
	---help---
		Driver for QEMU PCI test device

config VIRT_JH_IVSHMEM
	bool "Driver for Jailhouse ivshmem 2.0"
	default n
	select PCI
	---help---
		Driver for Jailhouse Ivshmem 2.0

if VIRT_JH_IVSHMEM

config VIRT_JH_IVSHMEM_MAX_COUNT
	int "Maximum number of ivshmem devices"
	default 4

config VIRT_JH_IVSHMEM_BASE_IRQ
	int "Base IRQ Number for Ivhsmem devices"
	default 0

endif

endif # VIRT
```
